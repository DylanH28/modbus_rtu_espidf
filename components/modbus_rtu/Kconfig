## components/modbus_rtu/Kconfig
```kconfig
menu "Modbus RTU"
    config MODBUS_RTU_LOG_LEVEL
        int "Log level (0=none, 1=error, 2=warn, 3=info, 4=debug)"
        range 0 4
        default 3
endmenu
```
